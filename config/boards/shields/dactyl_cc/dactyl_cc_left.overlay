// dactyl_cc_left.overlay

#include "dactyl_cc.dtsi" // Notice that the main dtsi files are included in the overlay.

&kscan0 {
    col-gpios
        = <&gpio0 9  GPIO_ACTIVE_HIGH> // Col 0 (P0.09)
        , <&gpio0 10 GPIO_ACTIVE_HIGH> // Col 1 (P0.10)
        , <&gpio1 11 GPIO_ACTIVE_HIGH> // Col 2 (P1.11)
        , <&gpio1 13 GPIO_ACTIVE_HIGH> // Col 3 (P1.13)
        , <&gpio1 15 GPIO_ACTIVE_HIGH> // Col 4 (P1.15)
        , <&gpio0 2  GPIO_ACTIVE_HIGH> // Col 5 (P0.02)
        ;

    row-gpios
        = <&gpio0 22 (GPIO_ACTIVE_HIGH | GPIO_PULL_DOWN)> // Row 0 (P0.22)
        , <&gpio0 24 (GPIO_ACTIVE_HIGH | GPIO_PULL_DOWN)> // Row 1 (P0.24)
        , <&gpio1 0  (GPIO_ACTIVE_HIGH | GPIO_PULL_DOWN)> // Row 2 (P1.00)
        , <&gpio0 11 (GPIO_ACTIVE_HIGH | GPIO_PULL_DOWN)> // Row 3 (P0.11)
        , <&gpio1 4  (GPIO_ACTIVE_HIGH | GPIO_PULL_DOWN)> // Row 4 (P1.04)
        , <&gpio1 6  (GPIO_ACTIVE_HIGH | GPIO_PULL_DOWN)> // Row 5 (P1.06)
        ;
};
